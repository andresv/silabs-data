# FAKE_MG26_MIN register map
Vendor: Silicon Labs; Series: EFR32; File version: B
Minimal NS/S TrustZone fixture
Registers are 32-bit, read-write, reset 0x0 unless marked. A register's access mark holds for its fields unless they carry their own. Offsets are from the block's base; lines under a group give offsets from that group; [hi:lo] are bit positions; {n}, {i} and the like mark numbered series; 'fields as' and 'values as' point back to an identical list; <NAME> marks a mode.

## Memory map
0x4000A000 EUSART0_NS
0x5000A000 EUSART0_S

## EUSART0_NS
Base 0x4000A000
Same registers: EUSART0_S 0x5000A000
0x04 EN — Enable
  [0] EN — Enable bit
0x08 STATUS ro reset 0x10
  [0] READY
