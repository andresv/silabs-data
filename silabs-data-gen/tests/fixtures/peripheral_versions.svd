# FAKE_MG26_VERSIONS register map
Vendor: Silicon Labs; Series: EFR32; File version: B
Hand-crafted fixture pinning canonical EFR32MG26 peripheral versions.
Registers are 32-bit, read-write, reset 0x0 unless marked. A register's access mark holds for its fields unless they carry their own. Offsets are from the block's base; lines under a group give offsets from that group; [hi:lo] are bit positions; {n}, {i} and the like mark numbered series; 'fields as' and 'values as' point back to an identical list; <NAME> marks a mode.

## Memory map
0x4000A000 ACMP0_NS
0x4000B000 CMU_NS
0x4000C000 GPIO_NS
0x4000D000 EUSART0_NS
0x4000E000 MSC_NS

## ACMP0_NS
Base 0x4000A000
Same registers: CMU_NS 0x4000B000, GPIO_NS 0x4000C000, EUSART0_NS 0x4000D000, MSC_NS 0x4000E000
0x04 EN
