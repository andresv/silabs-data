# FAKE_MG26_SUBSET register map
Vendor: Silicon Labs; Series: EFR32; File version: B
Hand-built MG26 subset mirroring the real-pack ground truth: 7 shared kinds (matching version + registers vs MG24) and 3 split kinds (GPIO v7, CMU v7, MSC v9 — different registers from MG24).
Registers are 32-bit, read-write, reset 0x0 unless marked. A register's access mark holds for its fields unless they carry their own. Offsets are from the block's base; lines under a group give offsets from that group; [hi:lo] are bit positions; {n}, {i} and the like mark numbered series; 'fields as' and 'values as' point back to an identical list; <NAME> marks a mode.

## Memory map
0x4900A000 ACMP0_NS
0x4900B000 BURTC_NS
0x4900C000 EUSART0_NS
0x4900D000 TIMER0_NS
0x4900E000 USART0_NS
0x4900F000 IADC0_NS
0x49010000 LDMA_NS
0x49011000 GPIO_NS
0x49012000 CMU_NS
0x49013000 MSC_NS
0x49020000 LETIMER0_NS
0x49021000 RTCC_NS
0x49022000 WDOG0_NS

## ACMP0_NS
Base 0x4900A000
Same registers: IADC0_NS 0x4900F000, WDOG0_NS 0x49022000
0x04 EN
0x08 CTRL

## BURTC_NS
Base 0x4900B000
Same registers: LETIMER0_NS 0x49020000
0x04 EN
0x10 CNT

## EUSART0_NS
Base 0x4900C000
0x04 EN
0x08 CFG0

## TIMER0_NS
Base 0x4900D000
0x04 EN
0x20 TOP

## USART0_NS
Base 0x4900E000
0x04 EN
0x10 FRAME reset 0x1005

## LDMA_NS
Base 0x49010000
0x04 EN
0x40 CHEN

## RTCC_NS
Base 0x49021000
0x04 EN
0x20 CNT

## GPIO_NS
Base 0x49011000
0x04 EN
0x100 PORTA_MODEL_V7

## CMU_NS
Base 0x49012000
0x04 EN
0x40 HFRCOCTRL_V7

## MSC_NS
Base 0x49013000
0x04 EN
0x0C WRITECTRL_V9
