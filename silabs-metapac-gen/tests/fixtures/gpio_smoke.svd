# EFR32_GPIO_SMOKE register map
Vendor: Silicon Labs; Series: EFR32; File version: B
GPIO-only smoke fixture exercising PORT[A-D]_* array recovery.
CPU: CM33 r0p4, little endian, no MPU, no FPU, 4 interrupt priority bits
Registers are 32-bit, read-write, reset 0x0 unless marked. A register's access mark holds for its fields unless they carry their own. Offsets are from the block's base; lines under a group give offsets from that group; [hi:lo] are bit positions; {n}, {i} and the like mark numbered series; 'fields as' and 'values as' point back to an identical list; <NAME> marks a mode.

## Memory map
0x4003C000 GPIO_S — GPIO secure alias (stripped pre-codegen)
0x5003C000 GPIO_NS — GPIO non-secure

## GPIO_NS — GPIO non-secure
Base 0x5003C000
0x40 PORTA_DOUT — Port A data out
  [15:0] DOUT — Data out bits
0x70 PORTB_DOUT — Port B data out
  [15:0] DOUT — Data out bits
0xA0 PORTC_DOUT — Port C data out
  [15:0] DOUT — Data out bits
0xD0 PORTD_DOUT — Port D data out
  [15:0] DOUT — Data out bits

## GPIO_S — GPIO secure alias (stripped pre-codegen)
Base 0x4003C000
0x40 PORTA_DOUT — Port A data out
  [15:0] DOUT — Data out bits
