# EFR32MG26_SMOKE register map
Vendor: Silicon Labs; Series: EFR32; File version: B
Smoke-test SVD modeled on EFR32MG26B211F2048IM68.
CPU: CM33 r0p4, little endian, no MPU, no FPU, 4 interrupt priority bits
Registers are 32-bit, read-write, reset 0x0 unless marked. A register's access mark holds for its fields unless they carry their own. Offsets are from the block's base; lines under a group give offsets from that group; [hi:lo] are bit positions; {n}, {i} and the like mark numbered series; 'fields as' and 'values as' point back to an identical list; <NAME> marks a mode.

## Memory map
0x4003C000 GPIO_S — GPIO secure alias
0x4B010000 EUSART0_S — EUSART0 secure alias
0x5003C000 GPIO_NS — GPIO non-secure
0x5B010000 EUSART0_NS — EUSART0 non-secure

## Interrupts
15 EUSART0_RX (EUSART0_NS)

## EUSART0_NS — EUSART0 non-secure
Base 0x5B010000
Same registers: EUSART0_S 0x4B010000
0x04 EN — Enable
  [0] EN — Enable bit
0x08 STATUS ro reset 0x10
  [0] READY

## GPIO_NS — GPIO non-secure
Base 0x5003C000
Same registers: GPIO_S 0x4003C000
0x40 PORTA_DOUT — Port A data out
  [15:0] DOUT — Data out bits
